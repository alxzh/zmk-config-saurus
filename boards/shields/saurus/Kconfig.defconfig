## boards/shields/saurus/Kconfig.defconfig
```kconfig
if SHIELD_SAURUS_LEFT

config ZMK_KEYBOARD_NAME
    default "Saurus"

config ZMK_SPLIT_ROLE_CENTRAL
    default y

config ZMK_STUDIO
    default y

endif

if SHIELD_SAURUS_LEFT || SHIELD_SAURUS_RIGHT

config ZMK_SPLIT
    default y

endif
```

## boards/shields/saurus/Kconfig.shield
```kconfig
config SHIELD_SAURUS_LEFT
    def_bool $(shields_list_contains,saurus_left)

config SHIELD_SAURUS_RIGHT
    def_bool $(shields_list_contains,saurus_right)
```
